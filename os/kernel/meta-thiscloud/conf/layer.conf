## os/kernel/meta-thiscloud/conf/layer.conf
```bitbake
# meta-thiscloud: THISCLOUD Yocto layer
# Builds kernel mainline + systemd + minimal server userspace

BBPATH .= ":${LAYERDIR}"

BBFILES += " \
    ${LAYERDIR}/recipes-*/*/*.bb \
    ${LAYERDIR}/recipes-*/*/*.bbappend \
"

BBFILE_COLLECTIONS += "meta-thiscloud"
BBFILE_PATTERN_meta-thiscloud := "^${LAYERDIR}/"
BBFILE_PRIORITY_meta-thiscloud = "6"

LAYERDEPENDS_meta-thiscloud = "core"
LAYERSERIES_COMPAT_meta-thiscloud = "scarthgap"
```
